## board/qemu-aarch64-virt/Config.in
```kconfig
config BOARD_QEMU_AARCH64_VIRT
	bool "qemu aarch64 virt machine"
	select PLATFORM_LINUX_LATEST
```

## board/qemu-arm-virt/Config.in
```kconfig
config BOARD_QEMU_ARM_VIRT
	bool "qemu arm virt machine"
	select PLATFORM_LINUX_LATEST
```
