## Config.in
```kconfig
mainmenu "Linux-Kernel-Lab"

source "kconfig/Config-build.in"

comment "Board"
source "output/config-board.in"
source "kconfig/Config-board.in"

comment "Platform"
choice
	prompt "Platform"
	config PLATFORM_LINUX_LATEST
		bool "Linux latest"
endchoice

comment "Packages"
```
